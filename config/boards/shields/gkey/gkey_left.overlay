#include "gkey.dtsi"

&default_transform {
    col-offset = <0>;
};

&kscan0 {
    compatible = "zmk,kscan-gpio-matrix";
    label = "KSCAN";
    diode-direction = "col2row";

    row-gpios
        = <&pro_micro 19 (GPIO_ACTIVE_HIGH | GPIO_PULL_DOWN)>  // ROW0
        , <&pro_micro 18 (GPIO_ACTIVE_HIGH | GPIO_PULL_DOWN)>  // ROW1
        , <&pro_micro 15 (GPIO_ACTIVE_HIGH | GPIO_PULL_DOWN)>  // ROW2
        , <&pro_micro 14 (GPIO_ACTIVE_HIGH | GPIO_PULL_DOWN)>  // ROW3
        , <&pro_micro 16 (GPIO_ACTIVE_HIGH | GPIO_PULL_DOWN)>  // ROW4
        ;

    col-gpios
        = <&pro_micro 2  GPIO_ACTIVE_HIGH>  // COL0
        , <&pro_micro 3  GPIO_ACTIVE_HIGH>  // COL1
        , <&pro_micro 4  GPIO_ACTIVE_HIGH>  // COL2
        , <&pro_micro 5  GPIO_ACTIVE_HIGH>  // COL3
        , <&pro_micro 6  GPIO_ACTIVE_HIGH>  // COL4
        , <&pro_micro 7  GPIO_ACTIVE_HIGH>  // COL5
        , <&pro_micro 8  GPIO_ACTIVE_HIGH>  // COL6
        ;
};
