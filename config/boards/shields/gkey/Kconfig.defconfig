## config/boards/shields/gkey/Kconfig.defconfig
```kconfig
if SHIELD_GKEY_LEFT

config ZMK_KEYBOARD_NAME
    default "GKey"

endif

if SHIELD_GKEY_LEFT || SHIELD_GKEY_RIGHT

config ZMK_SPLIT
    default y

config USB_DEVICE_STACK
    default y

config USB_DEVICE_PRODUCT
    default "GKey Split Keyboard"

config USB_DEVICE_MANUFACTURER
    default "Custom"

endif
```

## config/boards/shields/gkey/Kconfig.shield
```kconfig
config SHIELD_GKEY_LEFT
    def_bool $(shields_list_contains,gkey_left)

config SHIELD_GKEY_RIGHT
    def_bool $(shields_list_contains,gkey_right)
```
