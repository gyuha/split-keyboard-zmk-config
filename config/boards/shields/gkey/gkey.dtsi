#include <dt-bindings/zmk/matrix-transform.h>

/ {
    chosen {
        zmk,kscan = &kscan0;
    }

    default_transform: keymap_transform {
        compatible = "zmk,matrix-transform";
        columns = <16>;
        rows = <5>;
    };
};

kscan0: kscan0 {
    compatible = "zmk,kscan-gpio-matrix";
};
